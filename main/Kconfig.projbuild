## main/Kconfig.projbuild
```kconfig
menu "Application Configuration"

	config ESP_WIFI_SSID
		string "WiFi SSID"
		default "myssid"
		help
			SSID (network name) for the example to connect to.

	config ESP_WIFI_PASSWORD
		string "WiFi Password"
		default "mypassword"
		help
			WiFi password (WPA or WPA2) for the example to use.

	config ESP_MAXIMUM_RETRY
		int "Maximum retry"
		default 5
		help
			Set the Maximum retry to avoid station reconnecting to the AP unlimited when the AP is really inexistent.

	config MDNS_HOSTNAME
		string "mDNS Hostname"
		default "esp32-server"
		help
			The mDNS host name used by the ESP32.

	config NTP_SERVER
		string "NTP Server"
		default "pool.ntp.org"
		help
			Hostname for NTP Server.

	config LOCAL_TIMEZONE
		int "Your TimeZone"
		range 0 23
		default 0
		help
			Your local timezone.	When it is 0, Greenwich Mean Time.

endmenu
```
